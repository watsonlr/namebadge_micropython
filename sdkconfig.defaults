## sdkconfig.defaults
```kconfig
# ESP32-S3 Target Configuration
CONFIG_IDF_TARGET="esp32s3"

# Partition Table
CONFIG_PARTITION_TABLE_CUSTOM=y
CONFIG_PARTITION_TABLE_CUSTOM_FILENAME="partitions.csv"
CONFIG_PARTITION_TABLE_FILENAME="partitions.csv"

# ESP32S3-Specific
CONFIG_ESP32S3_DEFAULT_CPU_FREQ_240=y
CONFIG_ESP32S3_DATA_CACHE_64KB=y
CONFIG_ESP32S3_INSTRUCTION_CACHE_32KB=y

# PSRAM Configuration (2MB Octal PSRAM)
CONFIG_SPIRAM=y
CONFIG_SPIRAM_MODE_OCT=y
CONFIG_SPIRAM_SPEED_80M=y
CONFIG_SPIRAM_USE_MALLOC=y
CONFIG_SPIRAM_MALLOC_ALWAYSINTERNAL=16384
CONFIG_SPIRAM_TRY_ALLOCATE_WIFI_LWIP=y

# Compiler Options
CONFIG_COMPILER_OPTIMIZATION_SIZE=y
CONFIG_COMPILER_OPTIMIZATION_ASSERTIONS_DISABLE=y

# Serial Console
CONFIG_ESP_CONSOLE_UART_DEFAULT=y
CONFIG_ESP_CONSOLE_UART_NUM_0=y
CONFIG_ESP_CONSOLE_UART_BAUDRATE_115200=y

# MicroPython-specific optimizations
CONFIG_FREERTOS_HZ=1000
CONFIG_FREERTOS_USE_TRACE_FACILITY=y
CONFIG_FREERTOS_USE_STATS_FORMATTING_FUNCTIONS=y
CONFIG_FREERTOS_VTASKLIST_INCLUDE_COREID=y

# Increase main task stack size for MicroPython
CONFIG_ESP_MAIN_TASK_STACK_SIZE=16384

# Enable pthread support (needed by some MicroPython modules)
CONFIG_PTHREAD_TASK_STACK_SIZE_DEFAULT=8192

# Enable Bluetooth (optional, for BLE support in MicroPython)
CONFIG_BT_ENABLED=y
CONFIG_BTDM_CTRL_MODE_BLE_ONLY=y
CONFIG_BTDM_CTRL_MODE_BR_EDR_ONLY=n
CONFIG_BTDM_CTRL_MODE_BTDM=n

# Bootloader
CONFIG_BOOTLOADER_LOG_LEVEL_WARN=y

# Enable NVS encryption (optional security)
# CONFIG_NVS_ENCRYPTION=y
```
